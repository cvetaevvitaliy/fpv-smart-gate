## boards/arm/nrf52840_smart_gate/Kconfig
```kconfig
# nRF52840 SMART GATE board configuration

config BOARD_ENABLE_DCDC
	bool "Enable DCDC mode"
	select SOC_DCDC_NRF52X
	default y
	depends on BOARD_NRF52840_SMART_GATE
```

## boards/arm/nrf52840_smart_gate/Kconfig.board
```kconfig
# nRF52840 SMART GATE board configuration

config BOARD_NRF52840_SMART_GATE
	bool "nRF52840 SMART GATE"
	depends on SOC_NRF52840_QIAA
```

## boards/arm/nrf52840_smart_gate/Kconfig.defconfig
```kconfig
# nRF52840 SMART GATE board configuration

if BOARD_NRF52840_SMART_GATE

config BOARD
	default "nrf52840_smart_gate"

if USB

config USB_NRFX
	default y

config USB_DEVICE_STACK
	default y

endif # USB

config BT_CTLR
	default BT

endif # BOARD_NRF52840_SMART_GATE
```
